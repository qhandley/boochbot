## main/Kconfig.projbuild
```kconfig
menu "Boochbot Configuration"

    config EXAMPLE_MDNS_HOST_NAME
        string "mDNS Host Name"
        default "esp-home"
        help
            Specify the domain name used in the mDNS service.
            Note that webpage also take it as a part of URL where it will send GET/POST requests to.

    choice EXAMPLE_WEB_DEPLOY_MODE
        prompt "Website deploy mode"
        default EXAMPLE_WEB_DEPLOY_SEMIHOST
        help
            Select website deploy mode.
            You can deploy website to host, and ESP32 will retrieve them in a semihost way (JTAG is needed).
            You can deploy website to SD card or SPI flash, and ESP32 will retrieve them via SDIO/SPI interface.
            Detailed operation steps are listed in the example README file.
        config EXAMPLE_WEB_DEPLOY_SEMIHOST
            bool "Deploy website to host (JTAG is needed)"
            help
                Deploy website to host.
                It is recommended to choose this mode during developing.
        config EXAMPLE_WEB_DEPLOY_SD
            depends on IDF_TARGET_ESP32
            bool "Deploy website to SD card"
            help
                Deploy website to SD card.
                Choose this production mode if the size of website is too large (bigger than 2MB).
        config EXAMPLE_WEB_DEPLOY_SF
            bool "Deploy website to SPI Nor Flash"
            help
                Deploy website to SPI Nor Flash.
                Choose this production mode if the size of website is small (less than 2MB).
    endchoice

    if EXAMPLE_WEB_DEPLOY_SEMIHOST
        config EXAMPLE_HOST_PATH_TO_MOUNT
            string "Host path to mount (e.g. absolute path to web dist directory)"
            default "PATH-TO-WEB-DIST_DIR"
            help
                When using semihost in ESP32, you should specify the host path which will be mounted to VFS.
                Note that only absolute path is acceptable.
    endif

    config EXAMPLE_WEB_MOUNT_POINT
        string "Website mount point in VFS"
        default "/www"
        help
            Specify the mount point in VFS.

    config ONE_WIRE_GPIO
        int "OneWire GPIO number"
        range 0 33
        default 4
        help
            GPIO number (IOxx) to access One Wire Bus.

            Some GPIOs are used for other purposes (flash connections, etc.) and cannot be used.

            GPIOs 34-39 are input-only so cannot be used to drive the One Wire Bus.

    config ENABLE_STRONG_PULLUP_GPIO
        bool "Enable strong pull-up controlled by GPIO (MOSFET)"
        default n
        help
            An external circuit can be used to provide a strong pull-up to the One Wire Bus.
            This is useful when the bus has parasitic-powered devices and extra current is
            required to power them, such as during temperature ADC conversions.

            An example of such a circuit for the ESP32 is a P-channel MOSFET (such as the BS250)
            connected Source-to-Drain between a current-limiting resistor (e.g. 270ohm for 12mA
            max at 3.3V), itself connected to VCC, and the One Wire Bus data line. The Gate is
            connected to the GPIO specified here.

    config STRONG_PULLUP_GPIO
        int "Strong pull-up GPIO number"
        range 0 33
        default 5
        help
            GPIO number (IOxx) to control the strong pull-up on the One Wire Bus, perhaps
            via a P-channel MOSFET between VCC and the One Wire Bus data line.

            This GPIO will be set as an output and driven high during temperature conversion.
            This would enable the MOSFET providing current to the devices.

            At all other times it will be driven low, switching off the MOSFET and allowing
            the One Wire Bus to operate normally.

            Some GPIOs are used for other purposes (flash connections, etc.) and cannot be used.

            GPIOs 34-39 are input-only so cannot be used to drive the One Wire Bus.
        depends on ENABLE_STRONG_PULLUP_GPIO

endmenu
```
